## components/wifi/Kconfig.projbuild
```kconfig
menu "Network Configuration"
	config NETWORK_SCAN_LIST_SIZE
		int "Max scan of size list"
		range 0 20
		default 10

	config NETWORK_USE_SCAN_CHANNEL_BITMAP
		bool "Scan only non overlapping channels using Channel bitmap"
		default 0
	
	config NETWORK_USE_SCAN_LOOP
		bool "Scan network area every 15 seconds in a loop"
		default 0
endmenu
```
